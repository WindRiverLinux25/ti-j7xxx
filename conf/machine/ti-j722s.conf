## conf/machine/ti-j722s.conf
```bitbake
#@TYPE: Machine
#@NAME: ti-j722s
#@DESCRIPTION: Machine configuration for TI J722s SoC

MACHINEOVERRIDES:prepend = "j722s:"

require conf/machine/ti-j7.inc

DTB_FILES = "k3-j722s-evm.dtb k3-j722s-edgeai-apps.dtbo k3-j722s-vision-apps.dtbo k3-j722s-evm-csi2-quad-rpi-cam-imx219.dtbo"
KERNEL_DEVICETREE = "${@''.join('ti/%s ' % d for d in '${DTB_FILES}'.split())}"

IMAGE_BOOT_FILES ?= " Image ${DTB_FILES} u-boot.img tispl.bin tiboot3.bin uEnv.txt"
UBOOT_MACHINE = "j722s_evm_a53_defconfig"
DEFAULT_DTB ?= "k3-j722s-evm.dtb "
OPTEEMACHINE = "k3-am62x"
TARGET_PRODUCT = "j722s_linux"
TFA_BOARD = "lite"
TFA_PLATFORM = "k3"
```
